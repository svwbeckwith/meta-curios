## conf/layer.conf
```bitbake
# We have a conf and classes directory, add to BBPATH
BBPATH .= ":${LAYERDIR}"

# We have recipes-* directories, add to BBFILES
BBFILES += "${LAYERDIR}/recipes-*/*/*.bb \
            ${LAYERDIR}/recipes-*/*/*.bbappend"

BBFILE_COLLECTIONS += "../../meta-curios"
BBFILE_PATTERN_../../meta-curios = "^${LAYERDIR}/"
BBFILE_PRIORITY_../../meta-curios = "6"

LAYERSERIES_COMPAT_../../meta-curios = "dunfell"
```
